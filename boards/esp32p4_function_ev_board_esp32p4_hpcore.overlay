#include <zephyr/dt-bindings/display/panel.h>
#include <zephyr/dt-bindings/mipi_dsi/mipi_dsi.h>

/ {
	chosen {
		zephyr,console = &uart0;
	};
};

&ek79007 {
	pixel-format = <MIPI_DSI_PIXFMT_RGB565>;
};

&dsi_display {
	pixel-format = <PANEL_PIXEL_FORMAT_RGB_565>;
};