## Kconfig
```kconfig
mainmenu "pocketgen"

source "Kconfig.zephyr"

config POCKETGEN_SELF_TEST
	bool "Run MicroPython integration tests at startup"
	default n

config POCKETGEN_SYNTAX_HIGHLIGHT
	bool "Highlight Python source in the editor"
	default y

config POCKETGEN_HIGHLIGHT_BENCHMARK
	bool "Benchmark editor viewport highlighting at startup"
	default n

choice POCKETGEN_AUTOSTART
	prompt "Demo to run at startup"
	default POCKETGEN_AUTOSTART_NONE
	help
	  Load and run a demo after initializing the display and UART.
	  Ctrl+C interrupts the demo and returns to the editor. Startup
	  integration tests retain their normal maze behavior.

config POCKETGEN_AUTOSTART_NONE
	bool "No automatic execution"

config POCKETGEN_AUTOSTART_CUBE
	bool "3D Cube"

config POCKETGEN_AUTOSTART_MEGA
	bool "Mega Demo"

endchoice
```

## boards/esp32p4_function_ev_board_esp32p4_hpcore.conf
```kconfig
CONFIG_FPU=y
CONFIG_FPU_SHARING=y
CONFIG_UART_CONSOLE=y
CONFIG_EARLY_CONSOLE=n
CONFIG_POCKETGEN_AUTOSTART_MEGA=y
```
